&i2c0 {
    status = "okay";
    sda-pin = <17>;
    scl-pin = <20>;
    
    ssd1306: ssd1306@3c {
        compatible = "solomon,ssd1306fb";
        reg = <0x3c>;
        width = <128>;
        height = <32>; // Измените на 64, если экран высокий
        multiplex-ratio = <31>; // Измените на 63 для 128x64
        segment-remap;
        com-invdir;
    };
};
